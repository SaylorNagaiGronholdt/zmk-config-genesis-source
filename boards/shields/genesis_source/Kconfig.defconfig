## boards/shields/genesis_source/Kconfig.defconfig
```kconfig
if SHIELD_GENESIS_SOURCE_LEFT

config ZMK_KEYBOARD_NAME
    default "genesis-source"

config ZMK_SPLIT_ROLE_CENTRAL
    default y

endif # SHIELD_GENESIS_SOURCE_LEFT

if SHIELD_GENESIS_SOURCE_LEFT || SHIELD_GENESIS_SOURCE_RIGHT

config ZMK_SPLIT
    default y

endif # SHIELD_GENESIS_SOURCE_LEFT || SHIELD_GENESIS_SOURCE_RIGHT
```

## boards/shields/genesis_source/Kconfig.shield
```kconfig
config SHIELD_GENESIS_SOURCE_LEFT
    def_bool $(shields_list_contains,genesis_source_left)

config SHIELD_GENESIS_SOURCE_RIGHT
    def_bool $(shields_list_contains,genesis_source_right)
```

## config/west.yml
```yaml
manifest:
  defaults:
    revision: v0.3
  remotes:
    - name: zmkfirmware
      url-base: https://github.com/zmkfirmware
    # Additional modules containing boards/shields/custom code can be listed here as well
    # See https://docs.zephyrproject.org/3.2.0/develop/west/manifest.html#projects
  projects:
    - name: zmk
      remote: zmkfirmware
      import: app/west.yml
    - name: zmk-config-genesis-source
      url: https://github.com/SaylorNagaiGronholdt/zmk-config-genesis-source.git
      revision: main
      path: modules/zmk-config-genesis-source
  self:
    path: config
```
